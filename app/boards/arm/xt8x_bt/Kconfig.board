## app/boards/arm/xt8x_bt/Kconfig.board
```kconfig
# Copyright (c) 2022 The ZMK Contributors
# SPDX-License-Identifier: MIT

config BOARD_XT8x_BT
    bool "xt8x_bt"
    depends on SOC_NRF52840_QIAA
```

## app/boards/arm/xt8x_bt/Kconfig.defconfig
```kconfig
# Copyright (c) 2022 The ZMK Contributors
# SPDX-License-Identifier: MIT

if BOARD_XT8x_BT

config ZMK_KEYBOARD_NAME
    default "xt8x_bt"

if USB

config USB_NRFX
	default y

config USB_DEVICE_STACK
	default y
	
endif # USB

config BT_CTLR
    default BT

config ZMK_BLE
    default y

config ZMK_USB
    default y

endif # BOARD_XT8x_BT
```
